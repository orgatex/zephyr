## drivers/fuel_gauge/bq35100/Kconfig
```kconfig
# Copyright (c) 2024 Orgatex GmbH

# SPDX-License-Identifier: Apache 2.0

config BQ35100
	bool "BQ35100 Fuel Gauge"
	default y
	depends on DT_HAS_TI_BQ35100_ENABLED
	select I2C
	help
	  Enable I2C-based driver for BQ35100 Fuel Gauge.

if BQ35100

config BQ35100_MAX_RETRIES
	int "Status change retries"
	default 3
	help
	  Set the maximum number of retries
	  (read/write) for specific registers

endif # BQ35100
```

## dts/bindings/display/solomon,ssd1683.yaml
```yaml
---
# Copyright (c) 2024 Orgatex GmbH
# SPDX-License-Identifier: LicenseRef-Proprietary

description: Solomon Systech SSD1683 300x400 EPD display controller

compatible: "solomon,ssd1683"

include: solomon,ssd16xx-common.yaml
```
